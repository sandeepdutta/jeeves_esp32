## m5stick/main/Kconfig.projbuild
```kconfig
menu "micro-ROS application settings"

    config MICRO_ROS_APP_STACK
        int "Stack the micro-ROS app (Bytes)"
        default 16000
        help
        Stack size in Bytes of the micro-ROS app

    config MICRO_ROS_APP_TASK_PRIO
        int "Priority of the micro-ROS app"
        default 5
        help
        Priority of micro-ros task higher value means higher priority

    config MICRO_ROS_AGENT_DISCOVER
        bool "Discover Micros ROS Agent, used for WLAN || ETH"
        default N
        help
        Discover Micro ROS Agent used only for WLAN || ETH

    config BOARD_HAS_MICROPHONE
        bool "Board has a Microphone"
        default N
        help
        Select if board has a Microphone

if BOARD_HAS_MICROPHONE
    config MICROPHONE_SAMPLE_RATE
        int "Sampling rate for Microphone if present"
        default 16000
        help
        Sampling rate for Microphone if present

    config MICROPHONE_OVERSAMPLE
        int "Over Sampling factor for Microphone if present"
        default 2
        help
        Sampling rate for Microphone if present

    config MICROPHONE_SAMPLE_SIZE
        int "Samples to be read from the Microphone if present"
        default 512
        help
        Sample size for each read fom the Microphone if present
    config MICROPHONE_GAIN
        int "Multiplier for Microphone samples"
        default 32
        help
        Multiplier for Microphone samples
    config MICROPHONE_AUDIO_INFO
        bool "Publish AUDO INFO (Y/N)"
        default N
        help
        Y to publish audio info topic
endif
endmenu
```
